/** ###################################################################
**     THIS BEAN MODULE IS GENERATED BY THE TOOL. DO NOT MODIFY IT.
**     Filename  : MainMotor.C
**     Project   : SmartCar
**     Processor : MC9S12DG128BCPV
**     Beantype  : PWM
**     Version   : Bean 02.207, Driver 01.14, CPU db: 2.87.345
**     Compiler  : CodeWarrior HC12 C Compiler
**     Date/Time : 2010-3-8, 15:28
**     Abstract  :
**         This bean implements a pulse-width modulation generator
**         that generates signal with variable duty and fixed cycle. 
**     Settings  :
**         Used output pin             : 
**             ----------------------------------------------------
**                Number (on package)  |    Name
**             ----------------------------------------------------
**                       112           |  PP4_PWM4_KWP4
**             ----------------------------------------------------
**
**         Timer name                  : PWM4 [8-bit]
**         Counter                     : PWMCNT4   [176]
**         Mode register               : PWMCTL    [165]
**         Run register                : PWME      [160]
**         Prescaler                   : PWMPRCLK  [163]
**         Compare 1 register          : PWMPER4   [184]
**         Compare 2 register          : PWMDTY4   [192]
**         Flip-flop 1 register        : PWMPOL    [161]
**
**         User handling procedure     : not specified
**
**         Output pin
**
**         Port name                   : P
**         Bit number (in port)        : 4
**         Bit mask of the port        : 16
**         Port data register          : PTP       [600]
**         Port control register       : DDRP      [602]
**
**         Runtime setting period      : none
**         Runtime setting ratio       : calculated
**         Initialization:
**              Aligned                : Left
**              Output level           : low
**              Timer                  : Disabled
**              Event                  : Enabled
**         High speed mode
**             Prescaler               : divide-by-1
**             Clock                   : 8000000 Hz
**           Initial value of            period        pulse width (ratio 50%)
**             Xtal ticks              : 200           100
**             microseconds            : 12            6
**             seconds (real)          : 0.0000125     0.0000063
**
**     Contents  :
**         Enable         - byte MainMotor_Enable(void);
**         Disable        - byte MainMotor_Disable(void);
**         SetDutyTicks16 - byte MainMotor_SetDutyTicks16(word Ticks);
**
**     (c) Copyright UNIS, a.s. 1997-2008
**     UNIS, a.s.
**     Jundrovska 33
**     624 00 Brno
**     Czech Republic
**     http      : www.processorexpert.com
**     mail      : info@processorexpert.com
** ###################################################################*/


/* MODULE MainMotor. */

#include "MainMotor.h"

#pragma DATA_SEG MainMotor_DATA
#pragma CODE_SEG MainMotor_CODE

static bool EnUser;                    /* Enable/Disable device by user */
static word RatioStore;                /* Ratio of L-level to H-level */


/*
** ===================================================================
**     Method      :  HWEnDi (bean PWM)
**
**     Description :
**         Enables or disables the peripheral(s) associated with the bean.
**         The method is called automatically as a part of the Enable and 
**         Disable methods and several internal methods.
**         This method is internal. It is used by Processor Expert only.
** ===================================================================
*/
static void HWEnDi(void)
{
  if (EnUser) {                        /* Enable device? */
    PWME_PWME4 = 1;                    /* Run counter */
  } else {                             /* Disable device? */
    PWME_PWME4 = 0;                    /* Stop counter */
    PWMCNT4 = 0;                       /* Reset counter */
  }
}

/*
** ===================================================================
**     Method      :  SetRatio (bean PWM)
**
**     Description :
**         The method reconfigures the compare and modulo registers of 
**         the peripheral(s) when the speed mode changes. The method is 
**         called automatically as a part of the bean 
**         SetHigh/SetLow/SetSlow methods.
**         This method is internal. It is used by Processor Expert only.
** ===================================================================
*/
static void SetRatio(void)
{
  PWMDTY4 = (byte)(((100 * (dword)RatioStore) + 32768) >> 16); /* Calculate new value according to the given ratio */
}

/*
** ===================================================================
**     Method      :  MainMotor_Enable (bean PWM)
**
**     Description :
**         This method enables the signal generation 
**     Parameters  : None
**     Returns     :
**         ---        - Error code, possible codes:
**                           ERR_OK - OK
**                           ERR_SPEED - This device does not work in
**                           the active speed mode
** ===================================================================
*/
byte MainMotor_Enable(void)
{
  if (!EnUser) {                       /* Is the device disabled by user? */
    EnUser = TRUE;                     /* If yes then set the flag "device enabled" */
    HWEnDi();                          /* Enable the device */
  }
  return ERR_OK;                       /* OK */
}

/*
** ===================================================================
**     Method      :  MainMotor_Disable (bean PWM)
**
**     Description :
**         Disables the bean - it stops the signal generation and events calling.
**     Parameters  : None
**     Returns     :
**         ---        - Error code, possible codes:
**                           ERR_OK - OK
**                           ERR_SPEED - This device does not work in
**                           the active speed mode
** ===================================================================
*/
byte MainMotor_Disable(void)
{
  if (EnUser) {                        /* Is the device enabled by user? */
    EnUser = FALSE;                    /* If yes then set the flag "device disabled" */
    HWEnDi();                          /* Disable the device */
  }
  return ERR_OK;                       /* OK */
}

/*
** ===================================================================
**     Method      :  MainMotor_SetDutyTicks16 (bean PWM)
**
**     Description :
**         This method sets the new duty value of the output signal.
**         The duty is expressed in main oscillator (usualy External
**         osc., internal osc. if exits and external osc. is disabled)
**         ticks as a 16-bit unsigned integer number.
**     Parameters  :
**         NAME            - DESCRIPTION
**         Ticks           - Duty to set in main oscillator ticks
**                      (0 to 200 ticks in high speed mode)
**     Returns     :
**         ---             - Error code, possible codes:
**                           ERR_OK - OK
**                           ERR_SPEED - This device does not work in
**                           the active speed mode
**                           ERR_MATH - Overflow during evaluation
**                           ERR_RANGE - Parameter out of range
** ===================================================================
*/
byte MainMotor_SetDutyTicks16(word Ticks)
{
  dlong rtval;                         /* Result of two 32-bit numbers multiplication */

  PE_Timer_LngMul((dword)Ticks,(dword)21474836,&rtval); /* Multiply given value and high speed CPU mode coefficient */
  if (PE_Timer_LngHi2(rtval[0],rtval[1],&RatioStore)) { /* Is the result greater or equal than 65536 ? */
    RatioStore = 65535;                /* If yes then use maximal possible value */
  }
  SetRatio();                          /* Calculate and set up new appropriate values of the duty and period registers */
  return ERR_OK;                       /* OK */
}

/*
** ===================================================================
**     Method      :  MainMotor_Init (bean PWM)
**
**     Description :
**         Initializes the associated peripheral(s) and the bean's 
**         internal variables. The method is called automatically as a 
**         part of the application initialization code.
**         This method is internal. It is used by Processor Expert only.
** ===================================================================
*/
void MainMotor_Init(void)
{
  /* PWMCNT4: BIT7=0,BIT6=0,BIT5=0,BIT4=0,BIT3=0,BIT2=0,BIT1=0,BIT0=0 */
  setReg8(PWMCNT4, 0);                 /* Reset Counter */ 
  /* PWMSDN: PWMIF=1,PWMIE=0,PWMRSTRT=0,PWMLVL=0,??=0,PWM7IN=0,PWM7INL=0,PWM7ENA=0 */
  setReg8(PWMSDN, 128);                /* Emergency shutdown feature settings */ 
  RatioStore = 32768;                  /* Store initial value of the ratio */
  EnUser = FALSE;                      /* Disable device */
  /* PWMDTY4: BIT7=0,BIT6=0,BIT5=1,BIT4=1,BIT3=0,BIT2=0,BIT1=1,BIT0=0 */
  setReg8(PWMDTY4, 50);                /* Store initial value to the duty-compare register */ 
  /* PWMPER4: BIT7=0,BIT6=1,BIT5=1,BIT4=0,BIT3=0,BIT2=1,BIT1=0,BIT0=0 */
  setReg8(PWMPER4, 100);               /* and to the period register */ 
  /* PWMCLK: PCLK4=0 */
  clrReg8Bits(PWMCLK, 16);             /* Select clock source */ 
  HWEnDi();                            /* Enable/disable device according to status flags */
}

/* END MainMotor. */

/*
** ###################################################################
**
**     This file was created by UNIS Processor Expert 3.00 [04.12]
**     for the Freescale HCS12 series of microcontrollers.
**
** ###################################################################
*/
