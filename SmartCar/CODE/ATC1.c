/** ###################################################################
**     THIS BEAN MODULE IS GENERATED BY THE TOOL. DO NOT MODIFY IT.
**     Filename  : ATC1.C
**     Project   : SmartCar
**     Processor : MC9S12DG128BCPV
**     Beantype  : ADC
**     Version   : Bean 01.489, Driver 01.15, CPU db: 2.87.345
**     Compiler  : CodeWarrior HC12 C Compiler
**     Date/Time : 2010-3-13, 16:29
**     Abstract  :
**         This device "ADC" implements an A/D converter,
**         its control methods and interrupt/event handling procedure.
**         This device is designed for fast A/D conversions.
**     Settings  :
**         AD control register         : ATD1CTL2    [290]
**         AD control register         : ATD1CTL3    [291]
**         AD control register         : ATD1CTL4    [292]
**         AD control register         : ATD1CTL5    [293]
**         AD control register         : ATD1STAT0   [294]
**         AD control register         : ATD1STAT1   [299]
**         AD control register         : ATD1CTL23   [290]
**         AD control register         : ATD1CTL45   [292]
**         AD control register         : ATD1TEST1   [297]
**         AD control register         : ATD1DIEN    [301]
**         Priority                    : 
**         User handling procedure     : not specified
**         Number of conversions       : 8
**         AD resolution               : 8-bit
**
**         Input pins
**
**              Port name              : AD1
**              Bit number (in port)   : 0
**              Bit mask of the port   : 1
**              Port data register     : PORTAD1     [303]
**
**         Initialization:
**              Conversion             : Enabled
**              Event                  : Enabled
**         High speed mode
**             Prescaler               : divide-by-4
**     Contents  :
**         Measure    - byte ATC1_Measure(bool WaitForResult);
**         GetValue16 - byte ATC1_GetValue16(word *Values);
**
**     (c) Copyright UNIS, a.s. 1997-2008
**     UNIS, a.s.
**     Jundrovska 33
**     624 00 Brno
**     Czech Republic
**     http      : www.processorexpert.com
**     mail      : info@processorexpert.com
** ###################################################################*/


/* MODULE ATC1. */

#pragma MESSAGE DISABLE C5703          /* Disable warning C5703 "Parameter is not referenced" */
#pragma MESSAGE DISABLE C4002          /* Disable warning C4002 "Result not used is ignored" */
#pragma MESSAGE DISABLE C12056         /* Disable warning C12056 "SP debug info incorrect because of optimization or inline assembler" */

#include "ATC1.h"

#pragma DATA_SEG ATC1_DATA
#pragma CODE_SEG ATC1_CODE
#pragma CONST_SEG ATC1_CONST           /* Constant section for this module */

#define STOP            0              /* STOP state           */
#define MEASURE         1              /* MESURE state         */
#define CONTINUOUS      2              /* CONTINUOUS state      */


static bool OutFlg;                    /* Measurement finish flag */
volatile static byte ModeFlg;          /* Current state of device */
static byte SumCnt;                    /* Number of conversions */
static word ATC1_OutV;                 /* Array of measured values */
/*
** ===================================================================
**     Method      :  ATC1_Measure (bean ADC)
**
**     Description :
**         This method performs one measurement on all channels that
**         are set in the bean inspector. (Note: If the <number of
**         conversions> is more than one the conversion of A/D
**         channels is performed specified number of times.)
**     Parameters  :
**         NAME            - DESCRIPTION
**         WaitForResult   - Wait for a result
**                           of a conversion. If the <interrupt
**                           service> is disabled and a <number of
**                           conversions> is greater than 1, the
**                           WaitForResult parameter is ignored and
**                           the method waits for each result every
**                           time.
**     Returns     :
**         ---             - Error code, possible codes:
**                           ERR_OK - OK
**                           ERR_SPEED - This device does not work in
**                           the active speed mode
**                           ERR_DISABLED - Device is disabled
**                           ERR_BUSY - A conversion is already
**                           running
** ===================================================================
*/
byte ATC1_Measure(bool WaitForResult)
{
  if (ModeFlg != STOP) {               /* Is the device in different mode than "stop"? */
    return ERR_BUSY;                   /* If yes then error */
  }
  ModeFlg = MEASURE;                   /* Set state of device to the measure mode */
  SumCnt = 0;                          /* Set the number of conversions */
  OutFlg = FALSE;                      /* Output values aren't available */
  ATC1_OutV = 0;                       /* Set variable for storing measured values to 0 */
  /* ATD1CTL5: DJM=1,DSGN=0,SCAN=0,MULT=1,??=0,CC=0,CB=0,CA=0 */
  ATD1CTL5 = 144;                      /* Start the conversion */
  for (;;) {                           /* Calling MainMeasure while measurement completed */
    if (ATD1STAT0_SCF) {               /* Is a sequence completed? */
      ATC1_OutV += ATD1DR0L;           /* Save measured value */
      SumCnt++;
      if ( SumCnt == 8 ) {
        OutFlg = TRUE;                 /* Measured values are available */
        ModeFlg = STOP;                /* Set the device to the stop mode */
        break;
      }
      else {
        ATD1CTL5 = 144;                /* Start the conversion */
      }
    }
  }
  return ERR_OK;                       /* OK */
}

/*
** ===================================================================
**     Method      :  ATC1_GetValue16 (bean ADC)
**
**     Description :
**         This method returns the last measured values of all
**         channels justified to the left. Compared with <GetValue>
**         method this method returns more accurate result if the
**         <number of conversions> is greater than 1 and <AD
**         resolution> is less than 16 bits. In addition, the user
**         code dependency on <AD resolution> is eliminated.
**     Parameters  :
**         NAME            - DESCRIPTION
**       * Values          - Pointer to the array that
**                           contains the measured data.
**     Returns     :
**         ---             - Error code, possible codes:
**                           ERR_OK - OK
**                           ERR_SPEED - This device does not work in
**                           the active speed mode
**                           ERR_NOTAVAIL - Requested value not
**                           available
**                           ERR_OVERRUN - External trigger overrun
**                           flag was detected after last value(s)
**                           was obtained (for example by GetValue).
**                           This error may not be supported on some
**                           CPUs (see generated code).
** ===================================================================
*/
byte ATC1_GetValue16(word *Values)
{
  if (!OutFlg) {                       /* Is measured value(s) available? */
    return ERR_NOTAVAIL;               /* If no then error */
  }
  *Values = ATC1_OutV << 5;            /* Save measured values to the output buffer */
  return ERR_OK;                       /* OK */
}

/*
** ===================================================================
**     Method      :  ATC1_Init (bean ADC)
**
**     Description :
**         Initializes the associated peripheral(s) and the bean's 
**         internal variables. The method is called automatically as a 
**         part of the application initialization code.
**         This method is internal. It is used by Processor Expert only.
** ===================================================================
*/
void ATC1_Init(void)
{
  OutFlg = FALSE;                      /* No measured value */
  ModeFlg = STOP;                      /* Device isn't running */
  /* ATD1CTL4: SRES8=1,SMP1=0,SMP0=0,PRS4=0,PRS3=0,PRS2=0,PRS1=0,PRS0=1 */
  ATD1CTL4 = 129;                      /* Set resolution, sample time and prescaler */
  /* ATD1CTL3: ??=0,S8C=0,S4C=0,S2C=0,S1C=1,FIFO=0,FRZ1=0,FRZ0=0 */
  ATD1CTL3 = 8;                        /* Set ATD control register 3 */
  /* ATD1CTL2: ADPU=1,AFFC=1,AWAI=0,ETRIGLE=0,ETRIGP=0,ETRIGE=0,ASCIE=0,ASCIF=0 */
  ATD1CTL2 = 192;                      /* Set ATD control register 2 */
}


/* END ATC1. */

/*
** ###################################################################
**
**     This file was created by UNIS Processor Expert 3.00 [04.12]
**     for the Freescale HCS12 series of microcontrollers.
**
** ###################################################################
*/
